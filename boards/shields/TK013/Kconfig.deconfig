## boards/shields/TK13/Kconfig.deconfig
```kconfig
# Copyright (c) 2020 The ZMK Contributors
#SPDX-Lincense-Identifier: MIT

if SHIELD_TK13

config ZMK_KEYBOARD_NAME
     default "TK13"

endif
```

## boards/shields/TK13/Kconfig.shield
```kconfig
# Copyright (c) 2020 The ZMK Contributors
#SPDX-Lincense-Identifier: MIT

config SHIELD_TK13
    def_bool $(shields_list_contains,tk13)
```
